## config/west.yml
```yaml
manifest:
  remotes:
    - name: fabianw931
      url-base: https://github.com/fabianw931
    - name: zmkfirmware
      url-base: https://github.com/zmkfirmware
  projects:
    - name: zmk
      remote: zmkfirmware
      revision: main
      import: app/west.yml
    - name: blank-slate-zmk-module
      remote: fabianw931
      revision: core-zephyr-hwmv2-update
  self:
    path: config
```
